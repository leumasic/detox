## boards/shields/detox/Kconfig.defconfig
```kconfig
if SHIELD_DETOX_LEFT

config ZMK_KEYBOARD_NAME
    default "Detox"

config ZMK_SPLIT_ROLE_CENTRAL
    default y

config ZMK_STUDIO
    default y

endif

if SHIELD_DETOX_LEFT || SHIELD_DETOX_RIGHT

config ZMK_SPLIT
    default y

endif
```

## boards/shields/detox/Kconfig.shield
```kconfig
config SHIELD_DETOX_LEFT
    def_bool $(shields_list_contains,detox_left)

config SHIELD_DETOX_RIGHT
    def_bool $(shields_list_contains,detox_right)
```
